## Documentation/devicetree/bindings/display/bridge/ite,it66121.yaml
```yaml
# SPDX-License-Identifier: (GPL-2.0 OR BSD-2-Clause)
%YAML 1.2
---
$id: http://devicetree.org/schemas/display/bridge/ite,it66121.yaml#
$schema: http://devicetree.org/meta-schemas/core.yaml#

title: ITE it66121 HDMI bridge Device Tree Bindings

maintainers:
  - Phong LE <ple@baylibre.com>
  - Neil Armstrong <narmstrong@baylibre.com>

description: |
  The IT66121 is a high-performance and low-power single channel HDMI
  transmitter, fully compliant with HDMI 1.3a, HDCP 1.2 and backward compatible
  to DVI 1.0 specifications.

properties:
  compatible:
    const: ite,it66121

  reg:
    maxItems: 1
    description: base I2C address of the device

  reset-gpios:
    maxItems: 1
    description: GPIO connected to active low reset

  vrf12-supply:
    maxItems: 1
    description: Regulator for 1.2V analog core power.

  vcn33-supply:
    maxItems: 1
    description: Regulator for 3.3V digital core power.

  vcn18-supply:
    maxItems: 1
    description: Regulator for 1.8V IO core power.

  interrupts:
    maxItems: 1

  pclk-dual-edge:
    maxItems: 1
    description: enable pclk dual edge mode.

  port:
    type: object

    properties:
      endpoint:
        type: object
        description: |
          Input endpoints of the bridge.

    required:
      - endpoint

required:
  - compatible
  - reg
  - reset-gpios
  - vrf12-supply
  - vcn33-supply
  - vcn18-supply
  - interrupts
  - port

additionalProperties: false

examples:
  - |
    i2c6 {
      #address-cells = <1>;
      #size-cells = <0>;

      it66121hdmitx: it66121hdmitx@4c {
        compatible = "ite,it66121";
        pinctrl-names = "default";
        pinctrl-0 = <&ite_pins_default>;
        vcn33-supply = <&mt6358_vcn33_wifi_reg>;
        vcn18-supply = <&mt6358_vcn18_reg>;
        vrf12-supply = <&mt6358_vrf12_reg>;
        reset-gpios = <&pio 160 1 /* GPIO_ACTIVE_LOW */>;
        interrupt-parent = <&pio>;
        interrupts = <4 8 /* IRQ_TYPE_LEVEL_LOW */>;
        reg = <0x4c>;
        pclk-dual-edge;

        port {
          it66121_in: endpoint {
            remote-endpoint = <&display_out>;
          };
        };
      };
    };
```
